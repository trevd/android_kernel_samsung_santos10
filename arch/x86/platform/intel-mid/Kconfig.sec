## arch/x86/platform/intel-mid/Kconfig.sec
```kconfig
# arch/x86/platform/intel-mid/Kconfig.sec
#
# Copyright (C) 2013 Samsung Electronics Co, Ltd.
#
# This software is licensed under the terms of the GNU General Public
# License version 2, as published by the Free Software Foundation, and
# may be copied, distributed, and modified under those terms.
#
# This program is distributed in the hope that it will be useful,
# but WITHOUT ANY WARRANTY; without even the implied warranty of
# MERCHANTABILITY or FITNESS FOR A PARTICULAR PURPOSE.  See the
# GNU General Public License for more details.
#

config BOARD_CTP_SAMSUNG
	bool "CTP based Samsung Board Type"
	depends on BOARD_CTP
	default n

config BOARD_SAMSUNG_CLT3G
	bool "Samsung CLT3G Board"
	depends on BOARD_CTP_SAMSUNG
	select FW_SAMSUNG_CLT3G_TSP
	default n

config FW_SAMSUNG_CLT3G_TSP
	bool
	default n

config BOARD_SAMSUNG_SANTOS10
	bool "Samsung Santos10 Board (GT-P52xx)"
	depends on BOARD_CTP_SAMSUNG
	select FW_SAMSUNG_SANTOS10_TSP
	select FW_SAMSUNG_CLT3G_TSP
	default n

config FW_SAMSUNG_SANTOS10_TSP
	bool
	default n

config BLUETOOTH_BCM4330
	bool "Enable BCM4330 driver"
	default n
	help
	  Adds BCM4330 RFKILL driver for Broadcom BCM4330 chipset

config BLUETOOTH_BCM4334
	bool "Enable BCM4334 driver"
	default n
	help
	  Adds BCM4334 RFKILL driver for Broadcom BCM4334 chipset

config SAMSUNG_SERIAL_NUM
	bool "Print ARM architecture style serial number in /proc/cpuinfo"
	depends on BOARD_CTP_SAMSUNG
	default n
	help
	  Some userspace applications require a unique id to run.
	  In the Android platform, most of application assume that the current
	  running platform is ARM not x86.
	  This feature provides simple compatibility with ARM in x86.
```

## arch/x86/platform/intel-mid/sec_libs/Kconfig.debug
```kconfig
# arch/x86/platform/intel-mid/sec_libs/Kconfig.debug
#
# Copyright (C) 2013 Samsung Electronics Co, Ltd.
#
# This software is licensed under the terms of the GNU General Public
# License version 2, as published by the Free Software Foundation, and
# may be copied, distributed, and modified under those terms.
#
# This program is distributed in the hope that it will be useful,
# but WITHOUT ANY WARRANTY; without even the implied warranty of
# MERCHANTABILITY or FITNESS FOR A PARTICULAR PURPOSE.  See the
# GNU General Public License for more details.
#

menu "CTP Samsung Debug"
	depends on BOARD_CTP_SAMSUNG

config SAMSUNG_KERNEL_DEBUG
	bool "Samsung Kernel Debuging Code"
	select SEC_DEBUG
	default n

config SAMSUNG_USE_GETLOG
	bool "Samsung getLog Debuging Feature"
	default n
	help
	  Add a MARK string to the kernel log message indicating starting
	  addresses of 'FrameBuffer / printk Log buffer / Platform log buffer'.
	  This feature is used to extract debuging infomration from RAM-Dump.

config SAMSUNG_ADD_GAFORENSICINFO
	bool "Samsung GAF Debuging Feature"
	default n
	help
	  Add additional information to the RAM-Dump.
	  This information will be analized in GAF Tool.

config SAMSUNG_USE_LOGGER_ADDON
	bool "Samsung Use add-ons for android's logger"
	default n
	help
	  This feature make a log message which is started with !@ is displayed
	  throught printk function.
	  This also adds more platform logges in RAM-CONSOLE.

config SAMSUNG_PRINT_PLATFORM_LOG
	bool "Samsung Print Platform log into Console"
	depends on SAMSUNG_USE_LOGGER_ADDON
	default n
	help
	  This feature will print some critical(?) platfomr logs on the console
	  device. If ANDROID_RAM_CONSOLE feature is enabled at the same time,
	  platform log will not be displayed except 'ram-1'.

config SAMSUNG_USE_SEC_LOG_BUF
	bool "Samsung Use SEC_LOG_BUF"
	default n
	help
	  This feature stores all serial log messages into the SEC_LOG_BUF area.

config SAMSUNG_USE_SEC_XEN_CONSOLE
	bool "Samsung Use SEC_XEN CONSOLE"
	default n
	depends on XEN && XEN_DOM0
	help
	  This feature stores all serial log messages of xen into the kernel log.

config SAMSUNG_USE_LAST_SEC_LOG_BUF
	bool "Samsung Use LAST_SEC_LOG_BUF"
	depends on SAMSUNG_USE_SEC_LOG_BUF
	default n
	help
	  This feature creats a node to read contents of sec_log_buf area just
	  before booting into kernel from bootloader.
	  This is very helpful to read sec_log_buf area without reset or
	  entering upload mode.

config SAMSUNG_REPLACE_LAST_KMSG
	bool "Samsung Replace last_kmsg with SEC_LOG_BUF"
	depends on SAMSUNG_USE_LAST_SEC_LOG_BUF && !ANDROID_RAM_CONSOLE
	default n
	help
	  This feture will replace '/proc/last_kmsg' with SEC_LOG_BUF.
	  SEC_LOG_BUF and ANDROID_RAM_CONSOLE are similar features so, they are
	  sometimes not needed at the same time. As a result, if this feature
	  is enabled, SEC_LOG_BUF can be read through out '/proc/last_kmsg'
	  node.

config SAMSUNG_DIABLE_SEC_LOG_WHEN_TTY
	bool "Samsung disable SEC_LOG_BUF when tty is used"
	depends on SAMSUNG_USE_SEC_LOG_BUF && MACH_OMAP4_SAMSUNG
	default y
	help
	  Device is hanging when sec_log_buf and ttyOx are enabled at the
	  same time. This feature disables sec_log_buf when ttyOx is used.
	  Disabling sec_log_buf is not a big problem because, developer can
	  whatching a serial log through out the teminal program.

config SAMSUNG_DUMP_STACK_TRACE_FOR_ALL_CPUS
	bool "Samsung dump stack traces for all cpus"
	depends on SAMSUNG_KERNEL_DEBUG
	default n
	help
	  Say Y here to see stack traces for all cpus whe 'panic' is occured.
	  This feature will disable 'smp_send_stop' in panic fuction and call
	  'trigger_all_cpu_backtrace' to dump all stack traces.

	  If unsure, Say N.

menu "SAMSUNG Common Debugging Features"
menuconfig SEC_DEBUG
	bool "Samsung TN Ramdump Feature"
	select INTEL_SCU_IPC_UTIL_EMERG_OEMNIB
	default y
	help
	  Samsung TN Ramdump Feature. Use INFORM3 and magic number.

config SEC_DEBUG_SCHED_LOG
	bool "Samsung Scheduler Logging Feature"
	depends on SEC_DEBUG
	default n
	help
	  Samsung Scheduler Logging Feature for Debug use.

config SEC_DEBUG_SEMAPHORE_LOG
	bool "Samsung Semaphore Logging Feature"
	depends on SEC_DEBUG
	default n
	help
	  Samsung Semaphore Logging Feature for Debug use.

config SEC_DEBUG_USER
	bool "Panic on Userspace fault"
	depends on SEC_DEBUG
	default y
	help
	  Panic on Userspace fault.

config SEC_DEBUG_IRQ_EXIT_LOG
	bool "Temporary Logging for IRQ delay"
	depends on SEC_DEBUG
	default n
	help
	  Verbose Logging for IRQ dealy.

config SEC_DEBUG_XEN
	bool "Samsung Xen Debug Feature"
	depends on XEN && SEC_DEBUG
	default n
	help
	  Samsung Xen Debug Feature

endmenu

endmenu
```

## drivers/media/video/mhl/Kconfig
```kconfig
#
# mhl drivers configuration
#

menuconfig SAMSUNG_MHL
	tristate "MHL driver support"
	help
          If you want to use MHL driver,
          enable this option and other options below.

if SAMSUNG_MHL

comment "silicon image MHL trasmitter"

config SAMSUNG_MHL_92X4
        bool "Enable Sii92x4 MHL Chip Driver"
	depends on SAMSUNG_MHL
        default n
        ---help---
          support Sii92x4 MHL Chip Driver

config SAMSUNG_MHL_8240
        bool "Enable Sii8240 MHL Chip Driver"
	depends on SAMSUNG_MHL
        default n
        ---help---
          support Sii8240 MHL Chip Driver

config SAMSUNG_USE_11PIN_CONNECTOR
	bool "11pin micro-usb connector support"
	default n
	---help---
	  use 11pin micro usb connector instead of 5pin

config SAMSUNG_SMARTDOCK
	bool "smartdock support"
	default n

endif #SAMSUNG_MHL
```
